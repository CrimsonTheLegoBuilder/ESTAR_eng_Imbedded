#include <Arduino.h>
#include <ESP32-HUB75-MatrixPanel-I2S-DMA.h>
//#include "Dhole_weather_icons32px.h"

/*--------------------- DEBUG  -------------------------*/
#define Sprintln(a) (Serial.println(a))
#define SprintlnDEC(a, x) (Serial.println(a, x))

#define Sprint(a) (Serial.print(a))
#define SprintDEC(a, x) (Serial.print(a, x))


/*--------------------- RGB DISPLAY PINS -------------------------*/
#define R1_PIN 25
#define G1_PIN 26
#define B1_PIN 27
#define R2_PIN 14
#define G2_PIN 12
#define B2_PIN 13
#define A_PIN 23
#define B_PIN 19 // Changed from library default
#define C_PIN 5
#define D_PIN 17
#define E_PIN -1
#define LAT_PIN 4
#define OE_PIN 15
#define CLK_PIN 16


/*--------------------- MATRIX LILBRARY CONFIG -------------------------*/
#define PANEL_RES_X 64      // Number of pixels wide of each INDIVIDUAL panel module. 
#define PANEL_RES_Y 32     // Number of pixels tall of each INDIVIDUAL panel module.
#define PANEL_CHAIN 1      // Total number of panels chained one to another
 
MatrixPanel_I2S_DMA *dma_display = nullptr;

// Module configuration
HUB75_I2S_CFG mxconfig(
	PANEL_RES_X,   // module width
	PANEL_RES_Y,   // module height
	PANEL_CHAIN    // Chain length
);

/*
//Another way of creating config structure
//Custom pin mapping for all pins
HUB75_I2S_CFG::i2s_pins _pins={R1, G1, BL1, R2, G2, BL2, CH_A, CH_B, CH_C, CH_D, CH_E, LAT, OE, CLK};
HUB75_I2S_CFG mxconfig(
						64,   // width
						64,   // height
						 4,   // chain length
					 _pins,   // pin mapping
  HUB75_I2S_CFG::FM6126A      // driver chip
);

*/


//mxconfig.gpio.e = -1; // Assign a pin if you have a 64x64 panel
//mxconfig.clkphase = false; // Change this if you have issues with ghosting.
//mxconfig.driver = HUB75_I2S_CFG::FM6126A; // Change this according to your pane.


/*
 * Wifi Logo, generated with the following steps: 
 *
 * Python and Paint.Net needs to be installed.
 *
 * 1. SAVE BITMAP AS 1BIT COLOUR in paint.net
 * 2. Run: bmp2hex.py -i -x <BITMAP FILE>
 * 3. Copy paste output into sketch.
 * 
 */
 
const unsigned char wifi_image_rgb[] PROGMEM = {
  0x00,0x00,0x00,0x00,0x00,0x00,0x00,0x00,0x00,0x00,0x00,0x00,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0x00
};

void drawXbm565(int x, int y, int width, int height, const char *xbm, uint16_t color = 0xffff) 
{
  if (width % 8 != 0) {
      width =  ((width / 8) + 1) * 8;
  }
    for (int i = 0; i < width * height / 8; i++ ) {
      unsigned char charColumn = pgm_read_byte(xbm + i);
      for (int j = 0; j < 8; j++) {
        int targetX = (i * 8 + j) % width + x;
        int targetY = (8 * i / (width)) + y;
        if (bitRead(charColumn, j)) {
          dma_display->drawPixel(targetX, targetY, color);
        }
      }
    }
}

void drawXbmRGB(int x, int y, int width, int height, const unsigned char *xbm) {
  // 각 픽셀마다 3바이트(R, G, B)를 사용하므로 전체 크기는 width * height * 3이 됩니다.
  for (int i = 0; i < width * height; i++) {
    // 이미지의 각 픽셀에 대해 R, G, B 값을 읽어옵니다.
    uint8_t r = pgm_read_byte(xbm + i * 3);
    uint8_t g = pgm_read_byte(xbm + i * 3 + 1);
    uint8_t b = pgm_read_byte(xbm + i * 3 + 2);

    int targetX = i % width + x;
    int targetY = i / width + y;

    // 픽셀을 RGB565로 변환하여 화면에 출력합니다.
    // dma_display->drawPixel(targetX, targetY, dma_display->color565(r, g, b));
    dma_display->drawPixelRGB888(targetX, targetY, r, b, g);
  }
}

void drawXbmRGBOneColor(int x, int y, int width, int height, uint8_t r, uint8_t g, uint8_t b) {
  // 각 픽셀마다 3바이트(R, G, B)를 사용하므로 전체 크기는 width * height * 3이 됩니다.
  for (int i = 0; i < width * height; i++) {
    int targetX = i % width + x;
    int targetY = i / width + y;
    dma_display->drawPixelRGB888(targetX, targetY, r, g, b);
  }
}

void drawXbmRGB_shift(int x, int y, int width, int height, const unsigned char *xbm, int shift) {
  // 각 픽셀마다 3바이트(R, G, B)를 사용하므로 전체 크기는 width * height * 3이 됩니다.
  for (int i = 0; i < width * height; i++) {
    // 이미지의 각 픽셀에 대해 R, G, B 값을 읽어옵니다.
    uint8_t r = pgm_read_byte(xbm + i * 3);
    uint8_t g = pgm_read_byte(xbm + i * 3 + 1);
    uint8_t b = pgm_read_byte(xbm + i * 3 + 2);

    int targetX = (i % width + x - shift + width) % width;
    int targetY = i / width + y;

    // 픽셀을 RGB565로 변환하여 화면에 출력합니다.
    // dma_display->drawPixel(targetX, targetY, dma_display->color565(r, g, b));
    dma_display->drawPixelRGB888(targetX, targetY, r, b, g);
  }
}

void setup() {
  delay(1000); Serial.begin(115200); delay(200);

  /************** DISPLAY **************/
  Sprintln("...Starting Display");
  dma_display = new MatrixPanel_I2S_DMA(mxconfig);
  dma_display->begin();
  dma_display->setBrightness8(200); //0-255
  dma_display->clearScreen();
  
  dma_display->fillScreen(dma_display->color444(0, 1, 0));  

  //RGB 이미지를 표시합니다.
  drawXbmRGB(0, 0, 64, 32, wifi_image_rgb);

  delay(2000);
  // dma_display->clearScreen();
}

void loop() {
  // drawXbmRGBOneColor(0, 0, 64, 32, 255, 0, 0);
  // delay(2000);
  // drawXbmRGBOneColor(0, 0, 64, 32, 0, 255, 0);
  // delay(2000);
  // drawXbmRGBOneColor(0, 0, 64, 32, 0, 0, 255);
  // delay(2000);

  for (int i = 0; i < PANEL_RES_X; i++) {
    drawXbmRGB_shift(0, 0, 64, 32, wifi_image_rgb, i);
    delay(500);
  }
}